## drivers/soc/rockchip/Kconfig
```kconfig
# SPDX-License-Identifier: GPL-2.0-only
if ARCH_ROCKCHIP || COMPILE_TEST

#
# Rockchip Soc drivers
#

config ROCKCHIP_GRF
	bool "Rockchip General Register Files support" if COMPILE_TEST
	default y if ARCH_ROCKCHIP
	help
	  The General Register Files are a central component providing
	  special additional settings registers for a lot of soc-components.
	  In a lot of cases there also need to be default settings initialized
	  to make some of them conform to expectations of the kernel.

config ROCKCHIP_IODOMAIN
	tristate "Rockchip IO domain support"
	depends on OF
	help
	  Say y here to enable support io domains on Rockchip SoCs. It is
	  necessary for the io domain setting of the SoC to match the
	  voltage supplied by the regulators.

config ROCKCHIP_DTPM
	tristate "Rockchip DTPM hierarchy"
	depends on DTPM && m
	help
	  Describe the hierarchy for the Dynamic Thermal Power Management tree
	  on this platform. That will create all the power capping capable
	  devices.

config ROCKCHIP_IPA
	tristate "Rockchip IPA support"
	depends on THERMAL
	help
	  Say y here to enable rockchip IPA.
	  It will use thermal framework's mechanism to calculate
	  the SOC energy model power.

config ROCKCHIP_OPP
	tristate "Rockchip OPP select support"
	depends on PM_DEVFREQ
	select ROCKCHIP_IPA
	help
	  Say y here to enable rockchip OPP support.

config ROCKCHIP_SYSTEM_MONITOR
	tristate "Rockchip System Monitor support"
	depends on PM_DEVFREQ && ROCKCHIP_OPP
	help
	  Say y here to enable rockchip system monitor support.

config ROCKCHIP_SUSPEND_MODE
	tristate "Rockchip suspend mode config"
	depends on SUSPEND && ROCKCHIP_SIP
	help
	  Suspend mode configuration for Rockchip SoCs via ATF.

	  Supports multiple suspend modes (mem, mem-lite, mem-ultra)
	  with different power saving characteristics and wake latencies.
	  Also provides virtual poweroff functionality.

endif
```

## drivers/video/rockchip/Kconfig
```kconfig
# SPDX-License-Identifier: (GPL-2.0+ OR MIT)

menuconfig VIDEO_ROCKCHIP
	bool "Rockchip Video Devices"
	depends on ARCH_ROCKCHIP || COMPILE_TEST
	help
	  Support for Rockchip video processing devices including
	  hardware video encoders, decoders, and post-processors.

if VIDEO_ROCKCHIP

source "drivers/video/rockchip/mpp/Kconfig"
source "drivers/video/rockchip/rga3/Kconfig"

endif # VIDEO_ROCKCHIP
```
